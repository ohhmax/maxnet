// SPDX-License-Identifier: (GPL-2.0 OR MIT)

/dts-v1/;

#include "ipq9574-jidu6811.dtsi"

/ {
	model = "Jio JIDU6911";
	compatible = "jio,jidu6911", "jio,jidu6811", "jiorouter,ax6000-jidu6j11", "qcom,ipq9574";
};

&wifi0 {
	qcom,ath11k-calibration-variant = "JIDU6J11-6911";
};

&wifi1 {
	qcom,ath11k-calibration-variant = "JIDU6J11-6911";
};

