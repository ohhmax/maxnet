// SPDX-License-Identifier: (GPL-2.0 OR MIT)

/dts-v1/;

#include "ipq9574-jidu6811.dtsi"

/ {
	model = "Jio JIDU6911";
	compatible = "jio,jidu6911", "jio,jidu6811", "jiorouter,ax6000-jidu6j11", "qcom,ipq9574";
};
