// SPDX-License-Identifier: (GPL-2.0 OR MIT)

/dts-v1/;

#include "ipq9554-jiorouter-ax6000-jidu6j11.dtsi"

/ {
	model = "JioRouter AX6000 JIDU6J11-6811";
	compatible = "jiorouter,ax6000-jidu6j11-6811", "jiorouter,ax6000-jidu6j11", "jio,jidu6811", "qcom,ipq9574";
};

&wifi0 {
	status = "disabled";
};

&wifi1 {
	status = "disabled";
};

&q6v5_wcss {
	status = "disabled";
};
